#include <Wire.h>

#define OLED_ADDRESS 0x3C

const uint8_t font5x7[][5] PROGMEM = {
  {0x00, 0x00, 0x00, 0x00, 0x00}, 
  {0x00, 0x00, 0x5f, 0x00, 0x00}, 
  {0x00, 0x07, 0x00, 0x07, 0x00}, 
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  {0x61, 0x51, 0x49, 0x45, 0x43}  
};

#define BUTTON_PIN    2
#define BUZZER_PIN    8

int congestionRate = 12; 
int averageSpeed = 54;   
int flowCapacity = 88;   
char aiStatus[21] = "SYS: OPTIMAL        ";

unsigned long prevMillis = 0;
bool isSimulating = false;

void oled_command(uint8_t cmd) {
  Wire.beginTransmission(OLED_ADDRESS);
  Wire.write(0x00); 
  Wire.write(cmd);
  Wire.endTransmission();
}

void oled_data(uint8_t data) {
  Wire.beginTransmission(OLED_ADDRESS);
  Wire.write(0x40); 
  Wire.write(data);
  Wire.endTransmission();
}

void oled_init() {
  oled_command(0xAE); 
  oled_command(0xD5); oled_command(0x80); 
  oled_command(0xA8); oled_command(0x3F); 
  oled_command(0xD3); oled_command(0x00); 
  oled_command(0x40); 
  oled_command(0x8D); oled_command(0x14); 
  oled_command(0x20); oled_command(0x02); 
  oled_command(0xA1); 
  oled_command(0xC8); 
  oled_command(0xDA); oled_command(0x12); 
  oled_command(0x81); oled_command(0xCF); 
  oled_command(0xD9); oled_command(0xF1); 
  oled_command(0xDB); oled_command(0x40); 
  oled_command(0xA4); 
  oled_command(0xA6); 
  oled_command(0xAF); 
}

void oled_clear() {
  for (uint8_t page = 0; page < 8; page++) {
    oled_command(0xB0 + page);
    oled_command(0x00);
    oled_command(0x10);
    for (uint8_t i = 0; i < 128; i++) {
      oled_data(0x00);
    }
  }
}

void oled_set_cursor(uint8_t col, uint8_t page) {
  oled_command(0xB0 + page);
  oled_command(col & 0x0F);
  oled_command(0x10 | ((col >> 4) & 0x0F));
}

void oled_print_char(char c) {
  if (c < 32 || c > 90) c = 32; 
  if (c >= 97 && c <= 122) c -= 32; 
  
  uint8_t index = c - 32;
  for (uint8_t i = 0; i < 5; i++) {
    oled_data(pgm_read_byte(&(font5x7[index][i])));
  }
  oled_data(0x00); 
}

void oled_print(const char* str) {
  while (*str) {
    oled_print_char(*str++);
  }
}

void oled_print_int(int num) {
  char buf[6];
  itoa(num, buf, 10);
  oled_print(buf);
}

void setup() {
  pinMode(BUTTON_PIN, INPUT_PULLUP);
  pinMode(BUZZER_PIN, OUTPUT);
  
  Wire.begin();
  Wire.setClock(400000L);
  delay(100);
  oled_init();
  oled_clear();
  
  oled_set_cursor(10, 2);
  oled_print("MIHWAR ANALYTICS");
  oled_set_cursor(5, 4);
  oled_print("SYSTEM INITIALIZED");
  delay(2000);
  oled_clear();
}

void loop() {
  if (digitalRead(BUTTON_PIN) == LOW && !isSimulating) {
    delay(50); 
    isSimulating = true;
    prevMillis = millis();
    tone(BUZZER_PIN, 1200, 300); 
  }

  unsigned long currentMillis = millis();

  if (currentMillis - prevMillis >= 200) {
    if (!isSimulating) {
      congestionRate = 12 + random(-1, 3); 
      averageSpeed = 54 + random(-1, 2);
      flowCapacity = 90;
      strcpy(aiStatus, "SYS: OPTIMAL        ");
    } 
    else {
      unsigned long elapsed = currentMillis - prevMillis;

      if (elapsed < 5000) { 
        congestionRate = map(elapsed, 0, 5000, 15, 94); 
        averageSpeed = map(elapsed, 0, 5000, 54, 8);    
        flowCapacity = map(elapsed, 0, 5000, 90, 15);   
        strcpy(aiStatus, "CRITICAL ANOMALY   ");
      } 
      else if (elapsed >= 5000 && elapsed < 12000) { 
        congestionRate = 94;
        averageSpeed = 5;
        flowCapacity = 10;
        strcpy(aiStatus, "AI: DETOUR VIA B   "); 
      } 
      else if (elapsed >= 12000 && elapsed < 20000) { 
        congestionRate = map(elapsed, 12000, 20000, 94, 20); 
        averageSpeed = map(elapsed, 12000, 20000, 5, 48);   
        flowCapacity = map(elapsed, 12000, 20000, 10, 82);  
        strcpy(aiStatus, "GREEN WAVE ACTIVE  ");
      } 
      else { 
        isSimulating = false;
      }
    }

    drawAnalyticalDashboard();
  }
}

void drawAnalyticalDashboard() {
  oled_set_cursor(0, 0);
  oled_print("MAIN ROAD: ");
  oled_print_int(congestionRate);
  oled_print("% CONG  ");
  
  oled_set_cursor(0, 1);
  oled_print("---------------------");
  
  oled_set_cursor(0, 3);
  oled_print("AVG.SPD: ");
  oled_print_int(averageSpeed);
  oled_print(" KM/H   ");
  
  oled_set_cursor(0, 5);
  oled_print("CAPACITY: ");
  oled_print_int(flowCapacity);
  oled_print("/100  ");
  
  oled_set_cursor(0, 6);
  oled_print("---------------------");
  oled_set_cursor(0, 7);
  oled_print(aiStatus);
}
